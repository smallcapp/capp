## busybox/capp/Config.in
```kconfig
#
# For a description of the syntax of this configuration file,
# see scripts/kbuild/config-language.txt.
#

menu "Autelan Utils"

config APPKEY
	bool "appkey"
	default y
	help
	  appkey

config ATCOOKIE
	bool "atcookie"
	default y
	help
	  atcookie

config ATDOG
	bool "atdog"
	default y
	help
	  atdog

config ATOTP
	bool "atotp"
	default y
	help
	  atotp

config ATRT
	bool "atrt"
	default y
	help
	  atrt

config ATSS
	bool "atss"
	default y
	help
	  atss

config BOOTM
	bool "bootm"
	default y
	help
	  bootm

config JLOGGER
	bool "jlogger"
	default y
	help
	  jlogger

config JLOGD
	bool "jlogd"
	default y
	help
	  jlogd

config SMONITORC
	bool "smonitorc"
	default y
	help
	  smonitorc

config SMONITORD
	bool "smonitord"
	default y
	help
	  smonitord

config STIMERC
	bool "stimerc"
	default y
	help
	  stimerc

config STIMERD
	bool "stimerd"
	default y
	help
	  stimerd

config UMC
	bool "umc"
	default y
	help
	  umc

config UMD
	bool "umd"
	default y
	help
	  umd
endmenu
```
